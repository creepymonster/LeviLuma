## controller-round/main/Kconfig.projbuild
```kconfig
menu "LeviLuma Round Controller"

    config LEVILUMA_CTRL_NAME
        string "Name des Controllers (fuer das Gateway)"
        default "LeviLuma Rund"
        help
            Wird beim Koppeln an das Gateway gemeldet. Hoechstens 24 Zeichen.

    config LEVILUMA_WIFI_TX_POWER
        int "Maximale WLAN-Sendeleistung (0,25 dBm pro Schritt)"
        range 8 84
        default 34
        help
            Standard 34 = 8,5 dBm wie LEVI_WIFI_TX_POWER im Legacy-Projekt.
            Gilt auch fuer ESP-NOW; der Funktreiber kann den Wert abstufen.

    menu "Display und Touch (wie Legacy Config.h)"
        config LEVILUMA_DISPLAY_SPI_MHZ
            int "SPI-Takt Display (MHz), Legacy LEVI_DISPLAY_SPI_MHZ"
            range 1 80
            default 40
        config LEVILUMA_DISPLAY_INVERT
            bool "Panelfarben invertieren, Legacy LEVI_DISPLAY_INVERT"
            default y
        config LEVILUMA_BACKLIGHT_ACTIVE_HIGH
            bool "Hintergrundbeleuchtung High-aktiv, Legacy LEVI_BACKLIGHT_ACTIVE_HIGH"
            default y
        config LEVILUMA_DISPLAY_ROTATION
            int "Drehung in Grad (0, 90, 180, 270), Legacy LEVI_DISPLAY_ROTATION"
            default 0
        config LEVILUMA_TOUCH_OFFSET_ROTATION
            int "Touch-Drehung in LovyanGFX (0..7), Legacy LEVI_TOUCH_OFFSET_ROTATION"
            range 0 7
            default 0
            help
                Wert fuer 270 Grad ist in Legacy noch nicht am Geraet bestimmt.
        config LEVILUMA_TOUCH_BRIDGE_MS
            int "Ueberbrueckung kurzer Touch-Aussetzer (ms), Legacy LEVI_TOUCH_BRIDGE_MS"
            default 40
        config LEVILUMA_RGB565_SWAP
            bool "RGB565-Bytes tauschen, Legacy LEVI_RGB565_SWAP"
            default y
    endmenu

    config LEVILUMA_DIM_MS
        int "Hintergrundbeleuchtung aus nach (ms ohne Beruehrung)"
        default 20000
        help
            Wie Legacy: nach 20 s aus, eine Beruehrung schaltet sie wieder ein (und wird verworfen).

    config LEVILUMA_HOME_MS
        int "Zurueck zur Hauptansicht nach (ms ohne Beruehrung)"
        default 60000
        help
            Wie Legacy LEVI_RECENTER_MS.

    config LEVILUMA_INPUT_SEND_MS
        int "Mindestabstand fuer Befehle waehrend der Helligkeitsregler bewegt wird (ms)"
        range 20 1000
        default 120

endmenu
```

## controller/main/Kconfig.projbuild
```kconfig
menu "LeviLuma Controller"

    config LEVILUMA_CTRL_NAME
        string "Name des Controllers (fuer die Gateways)"
        default "LeviLuma Zentrale"
        help
            Wird beim Koppeln an das Gateway gemeldet. Hoechstens 24 Zeichen.

    config LEVILUMA_ZIGBEE_ENABLED
        bool "Zigbee aktivieren (FRITZ!Box-Anbindung)"
        depends on SOC_IEEE802154_SUPPORTED
        default n
        help
            Aktiviert den Zigbee-Stack, je Gateway einen Zigbee-Light-Endpoint (On/Off, Level, Color)
            und die Zigbee-Einstellungen in der Oberflaeche. Erfordert zusaetzlich CONFIG_ZB_ENABLED
            (siehe sdkconfig.defaults.zigbee). Standard: aus.

    menu "Zigbee"
        depends on LEVILUMA_ZIGBEE_ENABLED

        config LEVILUMA_ZB_CHANNEL_MASK
            hex "Erlaubte Zigbee-Kanaele (Bitmaske, Kanal 11..26)"
            default 0x07FFF800
            help
                Standard: alle Kanaele 11..26. Die FRITZ!Box waehlt den Kanal selbst.

        config LEVILUMA_ZB_MANUFACTURER
            string "Hersteller (Basic Cluster)"
            default "LeviLuma"

        config LEVILUMA_ZB_MODEL
            string "Modell (Basic Cluster)"
            default "LeviLuma-C5"

        config LEVILUMA_ZB_ED_KEEPALIVE_MS
            int "Keep-Alive des Endgeraets (ms)"
            default 3000
    endmenu

    menu "Display (ST7789, SPI)"
        config LEVILUMA_LCD_SPI_MHZ
            int "SPI-Takt Display (MHz)"
            range 1 80
            default 20
            help
                RockBase-Beispiele nutzen 20 MHz. Hoehere Werte am Geraet pruefen.
        config LEVILUMA_LCD_PIN_SCLK
            int "SCLK"
            default 6
        config LEVILUMA_LCD_PIN_MOSI
            int "MOSI"
            default 7
        config LEVILUMA_LCD_PIN_MISO
            int "MISO (gemeinsam mit Touch und SD)"
            default 2
        config LEVILUMA_LCD_PIN_CS
            int "CS"
            default 23
        config LEVILUMA_LCD_PIN_DC
            int "DC (im Schaltplan TFT_RS)"
            default 24
        config LEVILUMA_LCD_PIN_RST
            int "RESET (-1 = am Chip-Reset, laut Schaltplan)"
            default -1
        config LEVILUMA_LCD_PIN_BL
            int "Hintergrundbeleuchtung"
            default 25
        config LEVILUMA_LCD_BL_ACTIVE_HIGH
            bool "Hintergrundbeleuchtung High-aktiv"
            default y
        config LEVILUMA_LCD_INVERT
            bool "Farben invertieren"
            default n
            help
                RockBase-Setup fuer TFT_eSPI: TFT_INVERSION_OFF.
        config LEVILUMA_LCD_BGR
            bool "BGR-Reihenfolge"
            default n
        choice LEVILUMA_LCD_ROTATION
            prompt "Ausrichtung (Querformat 320x240)"
            default LEVILUMA_LCD_ROT_90
            config LEVILUMA_LCD_ROT_90
                bool "90 Grad"
            config LEVILUMA_LCD_ROT_270
                bool "270 Grad"
        endchoice
    endmenu

    menu "Touch (XPT2046, resistiv, SPI)"
        config LEVILUMA_TOUCH_PIN_CS
            int "CS"
            default 1
        config LEVILUMA_TOUCH_SPI_MHZ_X10
            int "SPI-Takt Touch (MHz x 10)"
            default 20
            help
                20 = 2,0 MHz (RockBase/TFT_eSPI: 2,5 MHz).
        config LEVILUMA_TOUCH_Z_THRESHOLD
            int "Mindestdruck (Z)"
            default 300
        config LEVILUMA_TOUCH_RAW_X_MIN
            int "Rohwert X min (ohne Kalibrierung)"
            default 300
        config LEVILUMA_TOUCH_RAW_X_MAX
            int "Rohwert X max"
            default 3800
        config LEVILUMA_TOUCH_RAW_Y_MIN
            int "Rohwert Y min"
            default 300
        config LEVILUMA_TOUCH_RAW_Y_MAX
            int "Rohwert Y max"
            default 3800
        config LEVILUMA_TOUCH_SWAP_XY
            bool "Rohachsen tauschen (ohne Kalibrierung)"
            default y
        config LEVILUMA_TOUCH_CAL_ON_FIRST_BOOT
            bool "Touch-Kalibrierung beim ersten Start"
            default y
            help
                Ohne gespeicherte Kalibrierung startet die Drei-Punkt-Kalibrierung automatisch.
    endmenu

    config LEVILUMA_DIM_MS
        int "Hintergrundbeleuchtung aus nach (ms ohne Beruehrung)"
        default 20000
        help
            Wie Legacy: nach 20 s aus, eine Beruehrung schaltet sie wieder ein (und wird verworfen).

    config LEVILUMA_HOME_MS
        int "Zurueck zur Uebersicht nach (ms ohne Beruehrung)"
        default 60000
        help
            Wie Legacy LEVI_RECENTER_MS.

endmenu
```

## debug/main/Kconfig.projbuild
```kconfig
menu "LeviLuma Diagnose (ESP-NOW-Empfaenger)"

    config LEVILUMA_DEBUG_CHANNEL_FOLLOW
        bool "Standardkanal = LeviLuma-ESP-NOW-Kanal (LEVILUMA_ESPNOW_CHANNEL)"
        default y
        help
            Empfang standardmaessig auf dem konfigurierten LeviLuma-Kanal (Menue "LeviLuma ESP-NOW").
            Zur Laufzeit per Monitorbefehl "channel <n>" aenderbar (nicht gespeichert).

    config LEVILUMA_DEBUG_CHANNEL
        int "Eigener Empfangskanal (2,4 GHz)"
        range 1 14
        default 1
        depends on !LEVILUMA_DEBUG_CHANNEL_FOLLOW
        help
            Wird nur verwendet, wenn der LeviLuma-Kanal nicht uebernommen wird. Zulaessig ist nur, was Hardware
            und Laenderregeln des Funktreibers erlauben; sonst meldet die Firmware den Fehler.

    config LEVILUMA_DEBUG_COUNTRY
        string "Laendercode fuer den Funktreiber (leer = Standard von ESP-IDF)"
        default ""
        help
            Optional, z. B. zwei Grossbuchstaben des eigenen Landes. Bestimmt, welche Kanaele (z. B. 12 und 13) erlaubt sind.
            Der Anwender ist fuer die Einhaltung der Vorschriften seines Landes verantwortlich.

    config LEVILUMA_DEBUG_SCAN_ENABLE
        bool "Kanalsuchlauf erlauben (Befehl \"scan\")"
        default n
        help
            Ausdruecklich aktivierbar. Beim Suchlauf wechselt der Empfaenger zyklisch den Kanal; Nachrichten
            auf allen anderen Kanaelen werden in der Zwischenzeit VERPASST. Ohne diese Option gibt es keinen Suchlauf.

    config LEVILUMA_DEBUG_SCAN_AT_BOOT
        bool "Suchlauf sofort nach dem Start beginnen"
        default n
        depends on LEVILUMA_DEBUG_SCAN_ENABLE

    config LEVILUMA_DEBUG_SCAN_DWELL_MS
        int "Verweilzeit je Kanal im Suchlauf (ms)"
        range 100 5000
        default 500
        depends on LEVILUMA_DEBUG_SCAN_ENABLE
        help
            Der LeviLuma-Beacon (ANNOUNCE) kommt standardmaessig alle 2 s: kuerzere Verweilzeiten finden ihn
            nicht zuverlaessig in einem Durchlauf.

    config LEVILUMA_DEBUG_SCAN_STAY_ON_HIT
        bool "Suchlauf beim ersten gueltigen LeviLuma-Rahmen beenden"
        default y
        depends on LEVILUMA_DEBUG_SCAN_ENABLE

    config LEVILUMA_DEBUG_QUEUE_LEN
        int "Laenge der Empfangs-Queue (Nachrichten)"
        range 4 64
        default 16
        help
            Jeder Eintrag belegt etwa 350 Byte RAM. Ist die Queue voll, wird die Nachricht verworfen und gezaehlt
            (Befehl "stats").

    config LEVILUMA_DEBUG_OUT_BUF
        int "Ausgabepuffer je Nachricht (Byte)"
        range 2048 16384
        default 6144
        help
            Laengere Ausgaben (z. B. CALIB mit Hexdump) werden gekuerzt und als gekuerzt gezaehlt.

    config LEVILUMA_DEBUG_ESPNOW_CB
        bool "Zusaetzlicher Empfangsweg: normaler ESP-NOW-Callback (Vergleich)"
        default n
        help
            Registriert zusaetzlich zum Promiscuous-Empfang den ESP-NOW-Empfang. Der normale Empfang liefert nur
            Rahmen, die an dieses Geraet oder per Broadcast gehen, ohne 802.11-Kopf. Doppelt eintreffende Rahmen
            werden erkannt und nur einmal ausgegeben. Das Geraet registriert keine Peers und sendet nichts.

    config LEVILUMA_DEBUG_DEDUP_MS
        int "Fenster der Doppelerkennung zwischen zwei Empfangswegen (ms)"
        range 5 500
        default 50
        depends on LEVILUMA_DEBUG_ESPNOW_CB

    config LEVILUMA_DEBUG_SHOW_ENCRYPTED
        bool "Verschluesselte Rahmen anfangs anzeigen"
        default y
        help
            Zur Laufzeit per "filter enc on|off" aenderbar.

    config LEVILUMA_DEBUG_ASCII
        bool "ASCII-Spalte im Hexdump anfangs anzeigen"
        default y

    config LEVILUMA_DEBUG_FULL_FRAME
        bool "Kompletten 802.11-Rahmen anfangs immer als Hexdump anzeigen"
        default n
        help
            Zur Laufzeit per "raw on|off" aenderbar. Nicht auswertbare Rahmen werden immer vollstaendig angezeigt.

endmenu
```

## next/gateway/main/Kconfig.projbuild
```kconfig
menu "LeviLuma Gateway"

    config LEVILUMA_GW_NAME
        string "Anzeigename (leer = LeviLuma-XXXX aus der MAC)"
        default ""
        help
            Name, den das Gateway in der Erkennung meldet. Hoechstens 24 Zeichen.
            Der Controller kann zusaetzlich einen eigenen Anzeigenamen vergeben.
            Ueber die serielle Konsole (Befehl "name") aenderbar, wird dann im NVS gespeichert.

    config LEVILUMA_GW_KEY
        string "Individueller Schluessel (32 Hex-Zeichen, leer = ohne Schluessel)"
        default ""
        help
            Optionaler ESP-NOW-LMK (16 Byte) fuer dieses Gateway. Derselbe Schluessel wird beim
            Koppeln am Controller eingegeben. Er wird nie per Funk uebertragen.
            Ein im NVS gespeicherter Schluessel (Konsole: "key <hex>") hat Vorrang.
            Ohne Schluessel: unverschluesselt, Kopplung nur im Kopplungsfenster.

    config LEVILUMA_PAIRING_WINDOW_S
        int "Kopplungsfenster ohne Schluessel (Sekunden)"
        range 0 3600
        default 300
        help
            Ohne Schluessel nimmt das Gateway neue Controller nur in diesem Zeitraum nach dem Start
            oder nach Druck auf die Kopplungstaste an. 0 = nur nach Tastendruck (dann 300 s).

    config LEVILUMA_PAIR_BUTTON_GPIO
        int "GPIO der Kopplungstaste (-1 = keine)"
        range -1 48
        default 0
        help
            XIAO ESP32S3: BOOT-Taste an GPIO0 (laut Seeed-Pinbelegung). Low-aktiv mit Pull-up.

    config LEVILUMA_STATUS_LED_GPIO
        int "GPIO der Status-LED (-1 = keine)"
        range -1 48
        default 21
        help
            XIAO ESP32S3: User-LED an GPIO21 (laut Seeed-Pinbelegung). Blinkt bei offenem
            Kopplungsfenster, leuchtet bei BLE-Verbindung. Polaritaet am Geraet pruefen.

    config LEVILUMA_STATUS_LED_ACTIVE_LOW
        bool "Status-LED leuchtet bei Low"
        default y

    config LEVILUMA_BRIGHTNESS_MAX
        int "Helligkeitsbereich des Bandes (100 oder 255)"
        default 100
        help
            Wie Legacy LEVI_BRIGHTNESS_MAX: 100 = Werte 0..100, 255 = Prozent auf 0..255 umgerechnet.

    config LEVILUMA_MIC_EQ_MODE
        int "Mikrofon-EQ-Modus nach Musik an (0..3)"
        range 0 3
        default 0
        help
            Wie Legacy LEVI_MIC_EQ_MODE: 0 normal, 1 weich, 2 dynamisch, 3 disko. Am Band ungetestet.

    config LEVILUMA_FADE_STEPS
        int "Schritte der Farbueberblendung"
        range 1 50
        default 1
        help
            Wie Legacy LEVI_FADE_STEPS (ein Schritt pro 200-ms-Fenster). 1 = Farbe springt direkt.

    config LEVILUMA_CALIB_GAIN_R
        int "Standard-Kalibrierung: Gain Rot (Promille)"
        range 0 2000
        default 1000

    config LEVILUMA_CALIB_GAIN_G
        int "Standard-Kalibrierung: Gain Gruen (Promille)"
        range 0 2000
        default 690

    config LEVILUMA_CALIB_GAIN_B
        int "Standard-Kalibrierung: Gain Blau (Promille)"
        range 0 2000
        default 940
        help
            Standard nach "Kalibrierung zuruecksetzen": lineare Kanal-Gains wie Legacy
            LEVI_CALIB_GR/GG/GB (1.000/0.690/0.940 = FastLED TypicalSMD5050).

    config LEVILUMA_CALIB_POINTS
        string "Standard-Kalibrierung: 30 Werte (leer = Gains verwenden)"
        default ""
        help
            Wie Legacy LEVI_CALIB_POINTS: 30 Zahlen 0..255, durch Komma getrennt
            (10 Zielfarben x R,G,B in der Reihenfolge von CalibCore.h).

endmenu
```
